## drivers/soc/oplus/performance/Kconfig
```kconfig
# SPDX-License-Identifier: GPL-2.0
# OPLUS Performance Optimization Drivers

menu "OPLUS Performance Optimization"

source "drivers/soc/oplus/performance/cpufreq_bouncing/Kconfig"
source "drivers/soc/oplus/performance/foreground_io_opt/Kconfig"
source "drivers/soc/oplus/performance/input_boost/Kconfig"
source "drivers/soc/oplus/performance/iomonitor/Kconfig"
source "drivers/soc/oplus/performance/lowmem_dbg/Kconfig"
source "drivers/soc/oplus/performance/memory_isolate/Kconfig"
source "drivers/soc/oplus/performance/multi_kswapd/Kconfig"
source "drivers/soc/oplus/performance/special_opt/Kconfig"
source "drivers/soc/oplus/performance/tpd/Kconfig"
source "drivers/soc/oplus/performance/tpp/Kconfig"
source "drivers/soc/oplus/performance/uifirst/Kconfig"
source "drivers/soc/oplus/performance/zwb_handle/Kconfig"
source "drivers/soc/oplus/performance/healthinfo/Kconfig"
source "drivers/soc/oplus/performance/im/Kconfig"
source "drivers/soc/oplus/performance/memleak_detect/Kconfig"
source "drivers/soc/oplus/performance/oplus_mm/Kconfig"
source "drivers/soc/oplus/performance/oplus_nandswap/Kconfig"

# Optional modules
source "drivers/soc/oplus/performance/gloom/Kconfig"
source "drivers/soc/oplus/performance/gloom_new/Kconfig"
source "drivers/soc/oplus/performance/ion_boost_pool/Kconfig"
source "drivers/soc/oplus/performance/multi_freearea/Kconfig"
source "drivers/soc/oplus/performance/vm_anti_fragment/Kconfig"

endmenu
```

## drivers/soc/oplus/performance/healthinfo/Kconfig
```kconfig
# SPDX-License-Identifier: GPL-2.0
# OPLUS Healthinfo Drivers

source "drivers/soc/oplus/performance/healthinfo/mm/Kconfig"
source "drivers/soc/oplus/performance/healthinfo/blk/Kconfig"
source "drivers/soc/oplus/performance/healthinfo/main/Kconfig"
source "drivers/soc/oplus/performance/healthinfo/ion/Kconfig"
```

## drivers/soc/oplus/performance/memleak_detect/Kconfig
```kconfig
# SPDX-License-Identifier: GPL-2.0
# OPLUS Memleak Detect Drivers

source "drivers/soc/oplus/performance/memleak_detect/svelte/Kconfig"
source "drivers/soc/oplus/performance/memleak_detect/oppo_svelte/Kconfig"
```

## drivers/soc/oplus/performance/oplus_mm/Kconfig
```kconfig
# SPDX-License-Identifier: GPL-2.0
# OPLUS MM Drivers

source "drivers/soc/oplus/performance/oplus_mm/zram_opt/Kconfig"
```

## drivers/soc/oplus/secureguard/Kconfig
```kconfig
# SPDX-License-Identifier: GPL-2.0
# OPLUS Security Drivers

menu "OPLUS Security"

config OPLUS_SECURE_GUARD
	bool "OPLUS Secure Guard Support"
	default y
	help
	  Enable OPLUS kernel security monitoring and root guard support.

if OPLUS_SECURE_GUARD

source "drivers/soc/oplus/secureguard/keventupload/Kconfig"
source "drivers/soc/oplus/secureguard/rootguard/Kconfig"

endif

endmenu
```

## drivers/soc/oplus/secureguard/keventupload/Kconfig
```kconfig
# SPDX-License-Identifier: GPL-2.0
# OPLUS Kevent Upload

config OPLUS_KEVENT_UPLOAD
	bool "OPLUS Kevent Upload Support"
	depends on OPLUS_SECURE_GUARD
	default y
	help
	  Enable OPLUS kernel event upload support for secure guard.
```

## drivers/soc/oplus/secureguard/rootguard/Kconfig
```kconfig
# SPDX-License-Identifier: GPL-2.0
# OPLUS Root Guard

config OPLUS_ROOT_CHECK
	bool "OPLUS Root Check Support"
	depends on OPLUS_SECURE_GUARD
	default y
	help
	  Enable OPLUS root detection hooks.

config OPLUS_MOUNT_BLOCK
	bool "OPLUS Mount Block Support"
	depends on OPLUS_SECURE_GUARD
	default y
	help
	  Enable OPLUS mount restriction hooks.

config OPLUS_EXECVE_BLOCK
	bool "OPLUS Execve Block Support"
	depends on OPLUS_SECURE_GUARD
	default y
	help
	  Enable OPLUS execve blocking hooks.

config OPLUS_EXECVE_REPORT
	bool "OPLUS Execve Report Support"
	depends on OPLUS_SECURE_GUARD
	default y
	help
	  Enable OPLUS execve reporting hooks.
```
